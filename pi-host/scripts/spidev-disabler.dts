/dts-v1/;
/plugin/;

/*
 * Disable only the spidev child device on SPI bus 10 (Pi 5 SPI0 on the 40-pin
 * header), leaving the spi10 bus controller alive for esp32_spi to claim.
 *
 * Uses target = <&spidev10> — the symbol is exported by the Pi 5 base DT
 * (confirmed: /proc/device-tree/__symbols__/spidev10 exists).
 *
 * Must be compiled with dtc -@ so that dtc emits __fixups__ instead of trying
 * to resolve the phandle at compile time.  The Pi 5 bootloader resolves fixups
 * against the base DTB's __symbols__ at boot, exactly like official overlays.
 */
/ {
	compatible = "brcm,bcm2712";

	fragment@0 {
		target = <&spidev10>;
		__overlay__ {
			status = "disabled";
		};
	};
};
