## esp-bridge/sdkconfig.defaults
```kconfig
# esp-bridge sdkconfig.defaults — ESP32-C5, UART↔TCP Klipper bridge
#
# Applied by: idf.py set-target esp32c5 && idf.py build
# Override any of these in sdkconfig.defaults.local (gitignored)

# ── Target ────────────────────────────────────────────────────────────────
CONFIG_IDF_TARGET="esp32c5"

# ── WiFi ──────────────────────────────────────────────────────────────────
# Power save off — single biggest latency win
CONFIG_ESP_WIFI_STA_DISCONNECTED_PM_ENABLE=n

# Keep WiFi 6 (802.11ax) enabled on the C5
CONFIG_ESP_WIFI_ENABLE_WPA3_SAE=y

# ── FreeRTOS ──────────────────────────────────────────────────────────────
# 1kHz tick — gives 1ms resolution for vTaskDelay
CONFIG_FREERTOS_HZ=1000

# ── Watchdog ──────────────────────────────────────────────────────────────
# Task watchdog enabled — bridge_task subscribes and resets it
CONFIG_ESP_TASK_WDT_EN=y
CONFIG_ESP_TASK_WDT_INIT=y
# Do NOT subscribe the idle tasks — we only watch bridge_task
CONFIG_ESP_TASK_WDT_CHECK_IDLE_TASK_CPU0=n

# ── Logging ───────────────────────────────────────────────────────────────
# Info in production; change to DEBUG for bring-up
CONFIG_LOG_DEFAULT_LEVEL_INFO=y

# ── WiFi latency tuning ──────────────────────────────────────────────────
# Disable AMPDU aggregation — reduces throughput but cuts latency significantly
CONFIG_ESP_WIFI_AMPDU_TX_ENABLED=n
CONFIG_ESP_WIFI_AMPDU_RX_ENABLED=n

# ── IRAM optimisations ────────────────────────────────────────────────────
# Place WiFi and UART ISRs in IRAM — avoids flash cache misses in interrupts
CONFIG_ESP_WIFI_IRAM_OPT=y
CONFIG_ESP_WIFI_RX_IRAM_OPT=y
CONFIG_UART_ISR_IN_IRAM=y

# ── Flash ─────────────────────────────────────────────────────────────────
# XIAO ESP32-C5 has 8MB flash
CONFIG_ESPTOOLPY_FLASHSIZE_8MB=y
CONFIG_ESPTOOLPY_FLASHFREQ_80M=y
```

## esp-hosted-pi/sdkconfig.defaults
```kconfig
# USB CDC-NCM + WiFi AP — base sdkconfig
CONFIG_ESPTOOLPY_FLASHSIZE_4MB=y
CONFIG_PARTITION_TABLE_CUSTOM=y

# TinyUSB (CDC-NCM network adapter)
CONFIG_TINYUSB=y
CONFIG_TINYUSB_NET_ENABLED=y

# WiFi
CONFIG_ESP_WIFI_ENABLED=y
CONFIG_ESP_WIFI_SOFTAP_SUPPORT=y

# Bluetooth disabled — not needed
CONFIG_BT_ENABLED=n

# Logging
CONFIG_LOG_DEFAULT_LEVEL_INFO=y
```

## esp-hosted-pi/sdkconfig.defaults.esp32c5
```kconfig
# ESP32-C5 specific overrides
CONFIG_IDF_TARGET="esp32c5"
CONFIG_ESPTOOLPY_FLASHSIZE_4MB=y
CONFIG_PARTITION_TABLE_CUSTOM_FILENAME="partitions.esp32c5.csv"

# C5 runs at 240MHz
CONFIG_ESP_DEFAULT_CPU_FREQ_MHZ_240=y

# USB OTG on C5 — full speed (USB HS not available on C5)
CONFIG_USB_OTG_SUPPORTED=y

# WiFi 6 (802.11ax) — C5 supports it natively
CONFIG_ESP_WIFI_ENABLE_11AX=y

# Disable SPIRAM — not fitted on DevKit V2
CONFIG_SPIRAM=n
# ESP-Hosted-FG slave: ESP32-C5 overrides for KlipperESPwifi
# Processed LAST — overrides both sdkconfig.defaults and C5 chip defaults.

# ── C5-specific hardware ───────────────────────────────────────────────────
CONFIG_ESP_DEFAULT_CPU_FREQ_MHZ_240=y
# ESP32-C5 DevKit V2.0 (H4 module) has 4MB flash
CONFIG_ESPTOOLPY_FLASHSIZE_4MB=y
CONFIG_PARTITION_TABLE_CUSTOM=y
CONFIG_PARTITION_TABLE_CUSTOM_FILENAME="partitions.esp32c5.csv"
CONFIG_ESP_CACHE_MALLOC=y
CONFIG_WIFI_CMD_BASIC_ONLY=y

# ── Force SPI transport (C5 supports SDIO too; must be explicit) ───────────
CONFIG_ESP_SPI_HOST_INTERFACE=y

# ── Disable BT — WiFi only for Klipper bridge ─────────────────────────────
# Overrides CONFIG_BT_ENABLED=y in sdkconfig.defaults
CONFIG_BT_ENABLED=n

# ── Disable Network Split — Pi handles all routing ─────────────────────────
# We do not want the C5 running its own LWIP stack / DHCP client.
# The Pi is the AP and handles all network routing.
CONFIG_NETWORK_SPLIT_ENABLED=n

# ── Watchdog ───────────────────────────────────────────────────────────────
CONFIG_ESP_TASK_WDT_EN=y
CONFIG_ESP_TASK_WDT_INIT=y
CONFIG_ESP_TASK_WDT_CHECK_IDLE_TASK_CPU0=n

# ── IRAM optimisations ─────────────────────────────────────────────────────
# Place WiFi ISRs in IRAM — avoids flash cache stalls during SPI transfers
CONFIG_ESP_WIFI_IRAM_OPT=y
CONFIG_ESP_WIFI_RX_IRAM_OPT=y

# ── Logging ────────────────────────────────────────────────────────────────
# Info only — verbose logs add SPI overhead during operation
CONFIG_LOG_DEFAULT_LEVEL_INFO=y

# ── GPIO pins ─────────────────────────────────────────────────────────────
# IMPORTANT: On ESP32-C5, the MSPI (flash) controller permanently owns the
# IO_MUX SPI2 pads (IO2, IO6, IO7, IO10) in DIO/QIO mode.  Using those for
# the GP-SPI slave causes all-0xFF on MISO because flash wins the pin.
#
# GPIO11/12 = UART0 TX/RX, GPIO13/14 = USB D-/D+ — also unavailable.
#
# We route SPI2 through the GPIO matrix to free pins on the right side:
#   MISO=IO23   MOSI=IO24   CLK=IO15   CS=IO28
#   Handshake=IO4   DataReady=IO5
CONFIG_ESP_SPI_HSPI_GPIO_MOSI=24
CONFIG_ESP_SPI_HSPI_GPIO_MISO=23
CONFIG_ESP_SPI_HSPI_GPIO_CLK=15
CONFIG_ESP_SPI_HSPI_GPIO_CS=28
CONFIG_ESP_SPI_GPIO_HANDSHAKE=4
CONFIG_ESP_SPI_GPIO_DATA_READY=5
```

## host_esp/sdkconfig.defaults
```kconfig
# sdkconfig.defaults for host ESP32-C5 (Pi5-side, SPI slave + WiFi 6 AP)
# Requires ESP-IDF 5.1+. Build with: pio run -e host_esp

# ── Flash ────────────────────────────────────────────────────────────────────
# Compact ESP32-C5-WROOM-1 module has 4 MB flash.
CONFIG_ESPTOOLPY_FLASHSIZE_4MB=y
CONFIG_ESPTOOLPY_FLASHSIZE="4MB"
CONFIG_ESPTOOLPY_FLASHMODE_DIO=y
CONFIG_ESPTOOLPY_FLASHFREQ_80M=y

# ── CPU ──────────────────────────────────────────────────────────────────────
# ESP32-C5 supports up to 240 MHz; 160 is a good balance of performance/power.
CONFIG_ESP_DEFAULT_CPU_FREQ_MHZ_160=y

# ── FreeRTOS ─────────────────────────────────────────────────────────────────
CONFIG_FREERTOS_HZ=1000

# ── WiFi ─────────────────────────────────────────────────────────────────────
CONFIG_ESP_WIFI_SOFTAP_SUPPORT=y
CONFIG_ESP_WIFI_ENABLE_WPA3_SAE=y
CONFIG_ESP_WIFI_MBEDTLS_CRYPTO=y
# Enable 802.11ax (WiFi 6 / HE) support – IDF 5.x key for C5
CONFIG_ESP_WIFI_ENABLE_11AX=y

# ── lwIP ─────────────────────────────────────────────────────────────────────
CONFIG_LWIP_MAX_SOCKETS=16
CONFIG_LWIP_TCP_KEEPALIVE=y
CONFIG_LWIP_SO_RCVBUF=y
CONFIG_LWIP_SO_LINGER=y
# Larger TCP buffers reduce latency jitter under SPI pacing
CONFIG_LWIP_TCP_SND_BUF_DEFAULT=8192
CONFIG_LWIP_TCP_WND_DEFAULT=8192

# ── NVS ──────────────────────────────────────────────────────────────────────
CONFIG_NVS_ENCRYPTION=n

# ── Logging ───────────────────────────────────────────────────────────────────
CONFIG_LOG_DEFAULT_LEVEL_INFO=y

# ── Stack / heap ──────────────────────────────────────────────────────────────
CONFIG_ESP_MAIN_TASK_STACK_SIZE=4096
CONFIG_ESP_SYSTEM_PANIC_PRINT_REBOOT=y

# ── Custom WiFi credentials (uncomment to bake into firmware) ────────────────
# CONFIG_KWM_WIFI_SSID="KlipperMesh"
# CONFIG_KWM_WIFI_PASSWORD="klipper42!"
# CONFIG_KWM_WIFI_CHANNEL=6
```

## mcu_esp/sdkconfig.defaults
```kconfig
# sdkconfig.defaults for MCU ESP32-C5 (STM32-side, UART bridge + WiFi 6 STA)

# ── CPU ──────────────────────────────────────────────────────────────────────
CONFIG_ESP_DEFAULT_CPU_FREQ_MHZ_160=y

# ── FreeRTOS ─────────────────────────────────────────────────────────────────
CONFIG_FREERTOS_HZ=1000

# ── WiFi ─────────────────────────────────────────────────────────────────────
CONFIG_ESP_WIFI_ENABLE_WPA3_SAE=y
CONFIG_ESP_WIFI_MBEDTLS_CRYPTO=y
CONFIG_ESP_WIFI_11AX_SUPPORT=y

# ── lwIP ─────────────────────────────────────────────────────────────────────
CONFIG_LWIP_MAX_SOCKETS=8
CONFIG_LWIP_TCP_KEEPALIVE=y
CONFIG_LWIP_SO_RCVBUF=y
CONFIG_LWIP_TCP_SND_BUF_DEFAULT=5120
CONFIG_LWIP_TCP_WND_DEFAULT=5120

# ── NVS ──────────────────────────────────────────────────────────────────────
CONFIG_NVS_ENCRYPTION=n

# ── Logging ───────────────────────────────────────────────────────────────────
CONFIG_LOG_DEFAULT_LEVEL_INFO=y

# ── Stack / heap ──────────────────────────────────────────────────────────────
CONFIG_ESP_MAIN_TASK_STACK_SIZE=4096
CONFIG_ESP_SYSTEM_PANIC_PRINT_REBOOT=y

# ── UART ──────────────────────────────────────────────────────────────────────
# Baud rate and pins are compile-time constants in uart_hal.h (KWM_UART_BAUD etc.)
# Override via build_flags in platformio.ini if needed.
```
